## member2/esp32_b_inspection/main/Kconfig.projbuild
```kconfig
menu "Inspection Station Wi-Fi"

    config INSPECTION_WIFI_SSID
        string "Hotspot name (SSID)"
        default ""

    config INSPECTION_WIFI_PASSWORD
        string "Hotspot password"
        default ""

endmenu

menu "Inspection Station TCP"
    config INSPECTION_TCP_PORT
        int "TCP listening port"
        range 1024 65535
        default 5001
    config INSPECTION_TRANSPORT_DIAGNOSTIC
        bool "Enable test-only framed echo (no inspection protocol)"
        default n
        help
            Echo received frames to test physical PC-to-B TCP communication.
            This is a transport diagnostic, never an application acknowledgement.
            Disable before implementing or testing production job processing.
endmenu
```
